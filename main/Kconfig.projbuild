## main/Kconfig.projbuild
```kconfig
menu "SNTP Configuration"

    choice SNTP_TIME_SYNC_METHOD
        prompt "Time synchronization method"
        default SNTP_TIME_SYNC_METHOD_IMMED
        help
            Time synchronization method.

        config SNTP_TIME_SYNC_METHOD_IMMED
            bool "update time immediately when received"
        config SNTP_TIME_SYNC_METHOD_SMOOTH
            bool "update time with smooth method (adjtime)"
        config SNTP_TIME_SYNC_METHOD_CUSTOM
            bool "custom implementation"
    endchoice

endmenu

menu "ESP32-TM1637 GPIO Configuration"

config TM1637_CLK_PIN
    int "TM1637 lcd CLK pin GPIO number"
        range 0 34
        default 18
        help
                GPIO number (IOxx) for CLK pin of TM1637 display.

                Some GPIOs are used for other purposes (flash connections, etc.) and cannot be used.

                GPIOs 35-39 are input-only so cannot be used to drive the One Wire Bus.

config TM1637_DIO_PIN
    int "TM1637 lcd DIO pin GPIO number"
    range 0 34
    default 19
    help
        GPIO number (IOxx) for DIO pin of TM1637 display.

        Some GPIOs are used for other purposes (flash connections, etc.) and cannot be used.

        GPIOs 35-39 are input-only so cannot be used to drive the One Wire Bus.

endmenu
```
